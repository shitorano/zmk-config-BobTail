## config/west.yml
```yaml
manifest:  
  remotes:  
    - name: zmkfirmware  
      url-base: https://github.com/zmkfirmware  
    - name: na-ka-no
      url-base: https://github.com/na-ka-no
    - name: mjmjm0101
      url-base: https://github.com/mjmjm0101
  
  projects:  
    - name: zmk
      remote: na-ka-no  # フォークしたリポジトリを参照  
      revision: for-cool642tb_mini  # カスタムブランチ名  
      import: app/west.yml  
    - name: zmk-pmw3610-driver  
      remote: na-ka-no
      revision: main  
    - name: zmk-input-processor-scroll-inertia
      remote: mjmjm0101
      revision: main
  
  self:  
    path: config
```
